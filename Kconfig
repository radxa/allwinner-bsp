## Kconfig
```kconfig
# SPDX-License-Identifier: GPL-2.0

menu "Allwinner BSP"

source "$(BSP_TOP)platform/Kconfig"
source "$(BSP_TOP)platform/Kconfig.debug"
source "$(BSP_TOP)drivers/Kconfig"
source "$(BSP_TOP)modules/nand/Kconfig"
source "$(BSP_TOP)modules/gpu/Kconfig"

endmenu
```

## drivers/Kconfig
```kconfig
# SPDX-License-Identifier: GPL-2.0-only

menu "Device Drivers"

# Minimal System
source "$(BSP_TOP)drivers/clk/Kconfig"
source "$(BSP_TOP)drivers/pinctrl/Kconfig"
source "$(BSP_TOP)drivers/uart/Kconfig"
source "$(BSP_TOP)drivers/timer/Kconfig"

# Basic System
source "$(BSP_TOP)drivers/dma/Kconfig"
source "$(BSP_TOP)drivers/rtc/Kconfig"
source "$(BSP_TOP)drivers/bus/Kconfig"
source "$(BSP_TOP)drivers/dumpreg/Kconfig"
source "$(BSP_TOP)drivers/watchdog/Kconfig"
source "$(BSP_TOP)drivers/iommu/Kconfig"
source "$(BSP_TOP)drivers/mbus/Kconfig"

# Storage
source "$(BSP_TOP)drivers/mmc/Kconfig"
source "$(BSP_TOP)drivers/ufs/Kconfig"
source "$(BSP_TOP)modules/nand/Kconfig"
source "$(BSP_TOP)drivers/mtd/Kconfig"
source "$(BSP_TOP)drivers/redeposit/Kconfig"

# Graphics
source "$(BSP_TOP)drivers/video/Kconfig"
source "$(BSP_TOP)drivers/g2d/Kconfig"
source "$(BSP_TOP)drivers/di/Kconfig"
source "$(BSP_TOP)drivers/vin/Kconfig"
source "$(BSP_TOP)drivers/vfe/Kconfig"
source "$(BSP_TOP)drivers/tvd/Kconfig"
source "$(BSP_TOP)drivers/drm/Kconfig"
source "$(BSP_TOP)drivers/gpu/Kconfig"
source "$(BSP_TOP)drivers/car_reverse/car_reverse_2_0/Kconfig"
source "$(BSP_TOP)drivers/car_reverse/car_reverse_amp/Kconfig"

# Multi-Media
source "$(BSP_TOP)drivers/ve/Kconfig"
source "$(BSP_TOP)drivers/rt-media/Kconfig"

# Audio
source "$(BSP_TOP)drivers/sound/Kconfig"

# Security
source "$(BSP_TOP)drivers/ce/Kconfig"
source "$(BSP_TOP)drivers/smc/Kconfig"
source "$(BSP_TOP)drivers/sid/Kconfig"
source "$(BSP_TOP)drivers/secure_storage/Kconfig"
source "$(BSP_TOP)drivers/drm_heap/Kconfig"

# I/O Connectivity
source "$(BSP_TOP)drivers/pcie/Kconfig"
source "$(BSP_TOP)drivers/phy/Kconfig"
source "$(BSP_TOP)drivers/emac/Kconfig"
source "$(BSP_TOP)drivers/gmac/Kconfig"
source "$(BSP_TOP)drivers/stmmac/Kconfig"
source "$(BSP_TOP)drivers/usb/Kconfig"
source "$(BSP_TOP)drivers/twi/Kconfig"
source "$(BSP_TOP)drivers/spi/Kconfig"
source "$(BSP_TOP)drivers/spi-ng/Kconfig"
source "$(BSP_TOP)drivers/ledc/Kconfig"
source "$(BSP_TOP)drivers/pwm/Kconfig"
source "$(BSP_TOP)drivers/ir-tx/Kconfig"
source "$(BSP_TOP)drivers/ir-rx/Kconfig"
source "$(BSP_TOP)drivers/gpadc/Kconfig"
source "$(BSP_TOP)drivers/lradc/Kconfig"
source "$(BSP_TOP)drivers/rtp/Kconfig"
source "$(BSP_TOP)drivers/input/Kconfig"
source "$(BSP_TOP)drivers/ata/Kconfig"
source "$(BSP_TOP)drivers/smartcard/Kconfig"
source "$(BSP_TOP)drivers/wiegand/Kconfig"

# Wireless
source "$(BSP_TOP)drivers/net/Kconfig"
source "$(BSP_TOP)drivers/bluetooth/Kconfig"

# Power Management
source "$(BSP_TOP)drivers/irqchip/Kconfig"
source "$(BSP_TOP)drivers/standby/Kconfig"
source "$(BSP_TOP)drivers/thermal/Kconfig"
source "$(BSP_TOP)drivers/nvmem/Kconfig"
source "$(BSP_TOP)drivers/pm_domain/Kconfig"
source "$(BSP_TOP)drivers/power/Kconfig"
source "$(BSP_TOP)drivers/cpufreq/Kconfig"
source "$(BSP_TOP)drivers/devfreq/Kconfig"
source "$(BSP_TOP)drivers/dsufreq/Kconfig"

# AMP/XPU
source "$(BSP_TOP)drivers/msgbox/Kconfig"
source "$(BSP_TOP)drivers/hwspinlock/Kconfig"
source "$(BSP_TOP)drivers/remoteproc/Kconfig"
source "$(BSP_TOP)drivers/rpmsg/Kconfig"
source "$(BSP_TOP)drivers/rpbuf/Kconfig"
source "$(BSP_TOP)drivers/npu/Kconfig"

# Misc
source "$(BSP_TOP)drivers/misc/Kconfig"
source "$(BSP_TOP)drivers/vendor_hooks/Kconfig"
source "$(BSP_TOP)drivers/aw_trace/Kconfig"

# Debugging
source "$(BSP_TOP)drivers/crashdump/Kconfig"
source "$(BSP_TOP)drivers/jtag/Kconfig"
source "$(BSP_TOP)drivers/debug/Kconfig"

# pstore
source "$(BSP_TOP)drivers/pstore/Kconfig"

# FS
source "$(BSP_TOP)drivers/fs/Kconfig"

#andes adaptor
source "$(BSP_TOP)drivers/andes_adaptor/Kconfig"

#awlink
source "$(BSP_TOP)drivers/awlink/Kconfig"

endmenu
```

## drivers/bus/Kconfig
```kconfig
# SPDX-License-Identifier: GPL-2.0-only
menu "Bus Drivers"
	depends on AW_BSP

config AW_NSI
	tristate "NSI Bus Support for Allwinner SoCs"
	depends on AW_BSP
	help
	  Support the NSI bus driver for Allwinner platforms.

config AW_NPD
	tristate "NPD Support for Allwinner SoCs"
	depends on AW_BSP
	help
	  Support the NPD(NSI PMU module's register data write to DDR module)
	  driver for Allwinner platforms.

endmenu
```

## drivers/drm/Kconfig
```kconfig
# SPDX-License-Identifier: GPL-2.0-only
menu "DRM Drivers"
	depends on AW_BSP

config AW_DRM
	tristate "DRM Support for Allwinner SoCs"
	depends on DRM && AW_BSP
	select DRM_KMS_HELPER
	select DRM_KMS_CMA_HELPER
	select DRM_KMS_DMA_HELPER
	select DRM_GEM_DMA_HELPER
	select DRM_DISPLAY_HELPER
	select VIDEOMODE_HELPERS
	default n

config AW_DRM_DE
	bool "Support Sunxi Display_Engine(DE)"
	depends on AW_DRM
	default y
	help
		If you want use DE of Version 35X, select it.

config AW_DRM_TCON
	bool "Support Timing Controller(TCON)"
	depends on AW_DRM
	default y
	help
		If you want use TCON, select it.

config AW_DRM_TCON_TOP
	bool "Support TCON TOP"
	depends on AW_DRM
	default y
	help
		If you want use TCON TOP, select it.

menuconfig AW_DRM_LCD
	bool "Support LCD Output"
	depends on AW_DRM
	default y
	help
		If you want lcd output for drm driver, select it.

config AW_DRM_LCD_DSI
	bool "Support LCD-DSI Output"
	select DRM_MIPI_DSI
	depends on AW_DRM_LCD
	default n
	help
		If you want lcd-dsi output for drm driver, select it.

config AW_DRM_LCD_DSI_COMBO_PHY
	bool "Support LCD-DSI COMBO PHY"
	depends on AW_DRM_LCD_DSI
	default y
	help
		If you want lcd-dsi combp phy, select it.

menuconfig AW_DRM_HDMI_TX
	tristate "Support Hdmi Output"
	depends on AW_DRM
	select DRM_DISPLAY_HDCP_HELPER
	select DRM_DISPLAY_HDMI_HELPER
	default y
	help
		If you want hdmi output for drm driver, select it.

menuconfig AW_DRM_HDMI14
	bool "Support HDMI1.4 Output"
	depends on AW_DRM_HDMI_TX
	default n
	help
		If you want hdmi1.4 output for drm driver, select it.

menuconfig AW_DRM_HDMI20
	bool "Support HDMI2.0 Output"
	depends on AW_DRM_HDMI_TX
	default y
	help
		If you want hdmi2.0 output for drm driver, select it.

config AW_HDMI20_HDCP14
	bool "HDMI2.0 HDCP1.4"
	depends on (AW_DRM_HDMI20)
	default n
	help
		Say Y here if you want to enable hdcp1.4 function.
		Say N here if you want to disable hdcp1.4 function.
		If unsure, say N.

config AW_HDMI20_HDCP22
	bool "HDMI2.0 HDCP2.2"
	depends on (AW_DRM_HDMI20)
	default n
	help
		Say Y here if you want to enable hdcp2.2 function.
		Say N here if you want to disable hdcp2.2 function.
		If unsure, say N.

config AW_HDMI20_CEC
	bool "HDMI2.0 CEC"
	depends on (AW_DRM_HDMI20)
	default n
	select CEC_CORE
	select CEC_NOTIFIER
	help
		Say Y here if you want to enable cec function.
			Also enable CEC_CORE and CEC_NOTIFIER.
		Say N here if you want to disable cec function.
		If unsure, say N.

menuconfig AW_DRM_EDP
	bool "Support eDP Output"
	depends on AW_DRM
	select VIDEOMODE_HELPERS
	default n
	help
		If you want edp/dp output for drm driver, select it.

config AW_DRM_EDP_PHY_USED
    def_bool n
    depends on (AW_DRM_EDP)
    default n
    help
        Selected when aw edp phy used.

config AW_DRM_INNO_EDP13
	bool "Support inno edp 1.3 PHY"
	depends on AW_DRM_EDP
    select AW_DRM_EDP_PHY_USED
	default n
	help
		If you want inno edp 1.3 as edp phy, select it.

source "$(BSP_TOP)drivers/drm/panel/Kconfig"

endmenu
```

## drivers/drm/panel/Kconfig
```kconfig
# SPDX-License-Identifier: GPL-2.0-or-later

menuconfig AW_DRM_PANEL
	tristate "Support panel based on DRM framework"
	depends on AW_DRM
	default n
	help
		If you want use DRM panel, select it.

config PANEL_SQ101D_Q5DI404_84H501H
	bool "SQ101D_Q5DI404_84H501H panel"
	depends on (AW_DRM_PANEL)
	select VIDEOMODE_HELPERS
	default n
	help
		If you want to support PANEL_SQ101D_Q5DI404_84H501H panel, select it.

config PANEL_BP101WX1
	bool "BP101WX1 LVDS panel"
	depends on (AW_DRM_PANEL)
	select VIDEOMODE_HELPERS
	default n
	help
		If you want to support PANEL_BP101WX1 panel, select it.

config PANEL_EDP_GENERAL
    tristate "eDP general drm panel"
	depends on (AW_DRM_PANEL)
	select VIDEOMODE_HELPERS
    default n
    help
        If you want to support general edp panel, select it.
```

## drivers/fs/linux-5.15/fs/Kconfig
```kconfig
# SPDX-License-Identifier: GPL-2.0-only

source "$(BSP_TOP)drivers/fs/linux-5.15/fs/fat/Kconfig"
```

## drivers/input/Kconfig
```kconfig
# SPDX-License-Identifier: GPL-2.0-only
#
# Input device configuration
#

menu "Input Device Drivers"
	depends on AW_BSP

config AW_INPUT_SENSORINIT
    tristate  "sunxi sensor init"
        depends on INPUT
        default m
        help
            init sunxi Sensors and CTP;
            If you say yes here you get support for Sensors and CTP init function;

source "$(BSP_TOP)drivers/input/ctp/Kconfig"
source "$(BSP_TOP)drivers/input/sensor/Kconfig"
source "$(BSP_TOP)drivers/input/misc/Kconfig"

endmenu # SUNXI_INPUT_DRIVER
```

## drivers/input/ctp/Kconfig
```kconfig
# SPDX-License-Identifier: GPL-2.0-only
#
# Touchscreen driver configuration
#

menuconfig AW_INPUT_CTP
	bool "Touchscreens input device support"
	help
	  Say Y here, and a list of supported touchscreens will be displayed.
	  This option doesn't affect the kernel.

	  If unsure, say Y.

if AW_INPUT_CTP

source "$(BSP_TOP)drivers/input/ctp/gt9xx_secondary//Kconfig"
source "$(BSP_TOP)drivers/input/ctp/gslx680new/Kconfig"
source "$(BSP_TOP)drivers/input/ctp/wacom_pen/Kconfig"
source "$(BSP_TOP)drivers/input/ctp/gt9xxnew/Kconfig"
source "$(BSP_TOP)drivers/input/ctp/gt9xx/Kconfig"
source "$(BSP_TOP)drivers/input/ctp/hynitron/Kconfig"
source "$(BSP_TOP)drivers/input/ctp/ilitek_tddi/Kconfig"
source "$(BSP_TOP)drivers/input/ctp/focaltech_touch/Kconfig"
source "$(BSP_TOP)drivers/input/ctp/tlsc6x/Kconfig"
source "$(BSP_TOP)drivers/input/ctp/gt82x/Kconfig"
source "$(BSP_TOP)drivers/input/ctp/nvt36xxx/Kconfig"

endif #touch input device support
```

## drivers/input/ctp/gt9xxnew/Kconfig
```kconfig
#
#  Touchscreen driver configuration
#
config  TOUCHSCREEN_GT9XXNEW_TS
       tristate  "gt9xxnew touchscreen driver"
       depends on INPUT && I2C
       default n
       help
         gt9xxnew touchscreen driver

config TOUCHSCREEN_GT9XXNEW_UPDATE
    tristate "Goodix GT9xxnew touch controller auto update support"
    depends on TOUCHSCREEN_GT9XXNEW_TS
    default n
    help
      Enable this for support firmware update.

      Say Y here if you want update touch controller firmware.

      If unsure, say N.

config TOUCHSCREEN_GT9XXNEW_TOOL
    tristate "Goodix GT9xxnew Tools for debuging"
    depends on TOUCHSCREEN_GT9XXNEW_TS
    default n
    help
      This implement interface support for Goodix GT9xx
      touchscreen debug.

      Say Y here if you want to have a Android app debug interface
      to your system.

      If unsure, say N.
```

## drivers/input/sensor/Kconfig
```kconfig
# SPDX-License-Identifier: GPL-2.0
#
# Makefile for the sensor drivers.
#
# Each configuration option enables a list of files.


menuconfig AW_INPUT_SENSOR
    bool "Sensor Input Device Support"
    help
      Say Y here, and a list of supported sensor will be displayed.
      This option doesn't affect the kernel.

      If unsure, say Y.

if AW_INPUT_SENSOR

source "$(BSP_TOP)drivers/input/sensor/sc7a20/Kconfig"
source "$(BSP_TOP)drivers/input/sensor/stk3x1x/Kconfig"
source "$(BSP_TOP)drivers/input/sensor/mir3da/Kconfig"
source "$(BSP_TOP)drivers/input/sensor/msa/Kconfig"
source "$(BSP_TOP)drivers/input/sensor/mmc5603/Kconfig"
source "$(BSP_TOP)drivers/input/sensor/bmi323/Kconfig"
source "$(BSP_TOP)drivers/input/sensor/qmi8658/Kconfig"

endif
```

## drivers/misc/Kconfig
```kconfig
# SPDX-License-Identifier: GPL-2.0

menu "Misc Devices Drivers"

config SUNXI_DIRECT_GPIO
	tristate "Sunxi direct gpio support"
	help
	  This driver provides a set of interfaces for direct control of gpio,
	  including setting input/output, pull-up/pull-down, drive capability and
	  other interfaces (mainly used for control of box lights, buzzers, etc.)

source "$(BSP_TOP)drivers/misc/sunxi-rf/Kconfig"
source "$(BSP_TOP)drivers/misc/sunxi-addr/Kconfig"
source "$(BSP_TOP)drivers/misc/sunxi-bootevent/Kconfig"
source "$(BSP_TOP)drivers/misc/sunxi-tvutils/Kconfig"
source "$(BSP_TOP)drivers/misc/leds/Kconfig"

endmenu
```

## drivers/net/Kconfig
```kconfig
# SPDX-License-Identifier: GPL-2.0

menu "Network Device Drivers"
	depends on NET

if NETDEVICES

source "$(BSP_TOP)drivers/net/wireless/Kconfig"

endif

endmenu
```

## drivers/net/wireless/Kconfig
```kconfig
menu "Wireless LAN"
	depends on !S390
	depends on NET

if WLAN

source "$(BSP_TOP)drivers/net/wireless/bcmdhd/Kconfig"
source "$(BSP_TOP)drivers/net/wireless/rtl8188fu/Kconfig"
source "$(BSP_TOP)drivers/net/wireless/rtl8723cs/Kconfig"
source "$(BSP_TOP)drivers/net/wireless/rtl8723ds/Kconfig"
source "$(BSP_TOP)drivers/net/wireless/rtl8723du/Kconfig"
source "$(BSP_TOP)drivers/net/wireless/rtl8822bs/Kconfig"
source "$(BSP_TOP)drivers/net/wireless/rtl8822cu/Kconfig"
source "$(BSP_TOP)drivers/net/wireless/rtl8852bs/Kconfig"
source "$(BSP_TOP)drivers/net/wireless/xr819/Kconfig"
source "$(BSP_TOP)drivers/net/wireless/xr829/Kconfig"
source "$(BSP_TOP)drivers/net/wireless/uwe5622/Kconfig"
source "$(BSP_TOP)drivers/net/wireless/aic8800/Kconfig"
source "$(BSP_TOP)drivers/net/wireless/atbm6023is/Kconfig"
source "$(BSP_TOP)drivers/net/wireless/ssv6158/Kconfig"
endif

endmenu
```

## drivers/net/wireless/aic8800/Kconfig
```kconfig
config AIC_WLAN_SUPPORT
	bool "AIC wireless Support"
	default n
	help
	  This is support for aic wireless chip.

if AIC_WLAN_SUPPORT
choice
    prompt "Select the interface type of the aic8800."
    default AIC8800_USB

config AIC8800_USB
    bool "AIC8800 USB Support"

config AIC8800_SDIO
    bool "AIC8800 SDIO Support"
    select PLATFORM_ALLWINNER
endchoice

config PLATFORM_ALLWINNER
    bool "AIC8800 Allwinner Support"

if AIC8800_USB
source "$(BSP_TOP)drivers/net/wireless/aic8800/usb/Kconfig"
endif
if AIC8800_SDIO
source "$(BSP_TOP)drivers/net/wireless/aic8800/sdio/Kconfig"
endif
endif
```

## drivers/net/wireless/aic8800/sdio/Kconfig
```kconfig
config AIC_FW_PATH
	depends on AIC_WLAN_SUPPORT
	string "Firmware & config file path"
	default "/vendor/etc/firmware"
	#default "/lib/firmware/aic8800_sdio"
	help
	  Path to the firmware & config file.

source "bsp/drivers/net/wireless/aic8800/sdio/aic8800_fdrv/Kconfig"
source "bsp/drivers/net/wireless/aic8800/sdio/aic8800_btlpm/Kconfig"
```

## drivers/net/wireless/aic8800/usb/Kconfig
```kconfig
source "bsp/drivers/net/wireless/aic8800/usb/aic8800_fdrv/Kconfig"
source "bsp/drivers/net/wireless/aic8800/usb/aic_load_fw/Kconfig"
source "bsp/drivers/net/wireless/aic8800/usb/aic_btusb/Kconfig"
```

## drivers/net/wireless/aic8800/usb/aic_btusb/Kconfig
```kconfig
config AIC_BTUSB_SUPPORT
	tristate "AIC Bluetooth USB driver"
	depends on USB && BT
	help
	  This is the driver for AIC Bluetooth USB devices.
	  Say Y here if you want to usb AIC Bluetooth USB devices.
```

## drivers/npu/Kconfig
```kconfig
# SPDX-License-Identifier: GPL-2.0

menu "NPU Drivers"

source "$(BSP_TOP)drivers/npu/aw_nna_vip/Kconfig"
source "$(BSP_TOP)drivers/npu/aw_nna_galcore/Kconfig"

endmenu
```

## drivers/pcie/Kconfig
```kconfig
# SPDX-License-Identifier: GPL-2.0-only

menu "PCIe Drivers"
	depends on AW_BSP

config AW_PCIE_RC
	tristate "Allwinner PCIe RC controller - Host mode"
	select PCI
	depends on AW_BSP
	help
	  Enables support for the PCIe RC controller in the Allwinner SoC.

config AW_PCIE_EP
	tristate "Allwinner PCIe EP controller - Endpoint mode"
	select PCI_ENDPOINT
	depends on AW_BSP
	help
	  Enables support for the PCIe EP controller in the Allwinner SoC.

endmenu
```
