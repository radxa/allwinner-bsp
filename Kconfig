## drivers/sound/Kconfig
```kconfig
# SPDX-License-Identifier: GPL-2.0-or-later
#
# Allwinner audio driver Kconfig
#
# Copyright(c) 2022-2027 Allwinnertech Co., Ltd.

menu "SOUND Drivers"
	depends on AW_BSP

if SND_SOC
	source "$(BSP_TOP)drivers/sound/codecs/Kconfig"
	source "$(BSP_TOP)drivers/sound/platform/Kconfig"
	source "$(BSP_TOP)drivers/sound/misc/Kconfig"
	source "$(BSP_TOP)drivers/sound/pa/Kconfig"
endif

endmenu
```

## drivers/stmmac/Kconfig
```kconfig
# SPDX-License-Identifier: GPL-2.0-only
menu "Stmmac Drivers"
	depends on AW_BSP

config AW_STMMAC_ETH
	tristate "Allwinner STMMAC driver"
	depends on NETDEVICES
	depends on !STMMAC_ETH
	depends on HAS_IOMEM && HAS_DMA
	depends on PTP_1588_CLOCK_OPTIONAL
	depends on OF && (ARCH_SUNXI || COMPILE_TEST)
	select MII
	select PAGE_POOL
	select PHYLINK
	select CRC32
	select RESET_CONTROLLER
	help
	  Support for Allwinner GMAC-200/GMAC-300 ethernet controllers.

	  This selects Allwinner SoC glue layer support for the
	  stmmac device driver. This driver is used for
	  GMAC-200/GMAC-300 ethernet controller.

if AW_STMMAC_ETH

config AW_STMMAC_SELFTESTS
	bool "Support for STMMAC Selftests"
	depends on INET
	depends on AW_STMMAC_ETH
	default n
	help
	  This adds support for STMMAC Selftests using ethtool. Enable this
	  feature if you are facing problems with your HW and submit the test
	  results to the netdev Mailing List.

config AW_TSN
	tristate "802.1 TSN Support"
	depends on AW_STMMAC_ETH
	depends on VLAN_8021Q && PTP_1588_CLOCK && CONFIGFS_FS
	help
	  Select this if you want to enable TSN on capable interfaces.

	  TSN allows you to set up deterministic links on your LAN (only
	  L2 is currently supported). Once loaded, the driver will probe
	  all available interfaces if they are capable of supporting TSN
	  links.

	  Once loaded, a directory in configfs called tsn/ will expose
	  the capable NICs and allow userspace to create
	  links. Userspace must provide us with a StreamID as well as
	  reserving bandwidth through the network and once this is done,
	  a new link can be created by issuing a mkdir() in configfs and
	  updating the attributes for the new link.

	  TSN itself does not produce nor consume data, it is dependent
	  upon 'shims' doing this, which can be virtually anything. ALSA
	  is a good candidate.

	  For more information, refer to the TSN-documentation in the
	  kernel documentation repository.

	  The resulting module will be called 'tsn'

	  If unsure, say N.

config AW_STMMAC_PCI
	tristate "STMMAC PCI bus support"
	depends on AW_STMMAC_ETH && PCI
	depends on COMMON_CLK
	help
	  This selects the platform specific bus support for the stmmac driver.
	  This driver was tested on XLINX XC2V3000 FF1152AMT0221
	  D1215994A VIRTEX FPGA board and SNPS QoS IPK Prototyping Kit.

	  If you have a controller with this interface, say Y or M here.

	  If unsure, say N.
endif

endmenu
```

## drivers/usb/Kconfig
```kconfig
# SPDX-License-Identifier: GPL-2.0
#
# USB configuration
#

menu "USB Drivers"
	depends on AW_BSP

if AW_BSP && USB_SUPPORT

source "$(BSP_TOP)drivers/usb/dwc3/Kconfig"

if USB

source "$(BSP_TOP)drivers/usb/host/Kconfig"

endif # USB

source "$(BSP_TOP)drivers/usb/sunxi_usb/Kconfig"

source "$(BSP_TOP)drivers/usb/typec/Kconfig"

source "$(BSP_TOP)drivers/usb/gadget/Kconfig"

source "$(BSP_TOP)drivers/usb/extcon/Kconfig"

source "$(BSP_TOP)drivers/usb/phy/Kconfig"

endif # USB_SUPPORT

endmenu
```

## drivers/usb/gadget/function/Kconfig
```kconfig
# SPDX-License-Identifier: GPL-2.0-only

if USB_GADGET

config USB_SUNXI_CONFIGFS_F_HID
	tristate "Allwinner HID function"
        depends on USB_SUNXI_GADGET
	depends on USB_CONFIGFS
	select USB_F_HID
	help
	  The HID function driver provides generic emulation of USB
	  Human Interface Devices (HID).

	  For more information, see Documentation/usb/gadget_hid.rst.

endif # USB_GADGET
```

## drivers/ve/Kconfig
```kconfig
# SPDX-License-Identifier: GPL-2.0

menu "VE Drivers"

source "$(BSP_TOP)drivers/ve/cedar-ve/Kconfig"
source "$(BSP_TOP)drivers/ve/google-ve/Kconfig"

endmenu
```

## drivers/video/Kconfig
```kconfig
# SPDX-License-Identifier: GPL-2.0-only
#
# fbdev configuration
#

source "$(BSP_TOP)drivers/video/sunxi/Kconfig"
```
